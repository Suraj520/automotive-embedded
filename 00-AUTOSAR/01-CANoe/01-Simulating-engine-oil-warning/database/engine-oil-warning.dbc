VERSION ""

NS_ :

BS_:

BU_: Engine
VAL_TABLE_ engine_oil_warning 1 "low" 0 "ok" ;

BO_ 256 engine_warning: 1 Engine
 SG_ engine_oil_low : 0|1@1+ (1,0) [0|1] "" Vector__XXX

BA_DEF_  "BusType" STRING ;
BA_DEF_DEF_  "BusType" "CAN";
VAL_ 256 engine_oil_low 1 "low" 0 "ok" ;
