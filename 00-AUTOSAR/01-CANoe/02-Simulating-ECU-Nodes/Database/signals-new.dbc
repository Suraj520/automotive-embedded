VERSION ""

NS_ :

BS_:

BU_:

BO_ 3221225472 VECTOR__INDEPENDENT_SIG_MSG: 0 Vector__XXX
 SG_ MainControlState : 0|8@1- (1,0) [0|1] "" Vector__XXX
 SG_ DoorState : 0|8@1- (1,0) [0|1] "" Vector__XXX

BO_ 512 Doors: 8 Vector__XXX

BO_ 256 MainControlMessage: 8 Vector__XXX

CM_ BO_ 3221225472 "This is a message for not used signals, created by Vector CANdb++ DBC OLE DB Provider.";
