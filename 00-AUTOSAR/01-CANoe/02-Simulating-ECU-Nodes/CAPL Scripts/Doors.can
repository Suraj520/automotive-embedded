/*@!Encoding:1252*/
variables
{
  message DoorsMessage msg;  // Define the message variable
}

on start
{
  // Initialization code for the Doors ECU
  msg.DoorsState = 0;  // Set the initial state to "Open"
  output(msg);  // Send the initial state message
  write("Doors ECU: Initialized with DoorsState = Open");
}

on message DoorsMessage
{
  // React to changes in the Doors state
  if (msg.DoorsState == 1)
  {
    // Doors are in the "Closed" state, perform relevant actions
    write("Doors ECU: Doors are now in the Closed state");
  }
  else
  {
    // Doors are in the "Open" state, perform relevant actions
    write("Doors ECU: Doors are now in the Open state");
  }
}

on key Button_Door_onoff // This event will trigger when the "Door_onoff" button is pressed or released
{
  if (msg.DoorsState == 0) // If Doors are Open
  {
    msg.DoorsState = 1; // Close the Doors
    write("Doors ECU: Doors are now closed");
  }
  else
  {
    msg.DoorsState = 0; // Open the Doors
    write("Doors ECU: Doors are now open");
  }
  output(msg); // Send the updated state message
}
