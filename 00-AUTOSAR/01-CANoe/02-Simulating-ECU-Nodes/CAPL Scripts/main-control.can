/*@!Encoding:1252*/
variables
{
  message MainControlMessage msg;  // Define the message variable
}

on start
{
  // Initialization code for the Main Control ECU
  msg.MainControlState = 0;  // Set the initial state to "Off"
  output(msg);  // Send the initial state message
  write("Main Control ECU: Initialized with MainControlState = Off");
}

on message MainControlMessage
{
  // React to changes in the Main Control state
  if (msg.MainControlState == 1)
  {
    // Main Control is in the "On" state, perform relevant actions
    // You can add your logic here
    write("Main Control ECU: Main Control is now in the On state");
  }
  else
  {
    // Main Control is in the "Off" state, perform relevant actions
    // You can add your logic here
    write("Main Control ECU: Main Control is now in the Off state");
  }
}
